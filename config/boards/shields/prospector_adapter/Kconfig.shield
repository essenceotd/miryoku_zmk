## config/boards/shields/prospector_adapter/Kconfig.shield
```kconfig
config SHIELD_PROSPECTOR_ADAPTER
    def_bool $(shields_list_contains,prospector_adapter)

if SHIELD_PROSPECTOR_ADAPTER

rsource "Kconfig"

endif
```

## config/boards/shields/toucan/Kconfig.defconfig
```kconfig
if SHIELD_TOUCAN_DONGLE

config ZMK_KEYBOARD_NAME
    default "TOUCAN"
    
config ZMK_SPLIT_ROLE_CENTRAL
    default y

config ZMK_USB
    default y

endif

if SHIELD_TOUCAN_LEFT || SHIELD_TOUCAN_RIGHT || SHIELD_TOUCAN_DONGLE

config ZMK_SPLIT
    default y

config ZMK_BLE
    default y

config SPI
    default y

config ZMK_POINTING
    default y

endif
```
